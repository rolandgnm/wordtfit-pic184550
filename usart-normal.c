/*Algoritmo InterpolaÃ§Ã£o de Lagrange*/
#include <p18f4550.h>
#include <stdio.h>
#include <stdlib.h>
#include <usart.h>
#include <string.h>


/*-------------------------------------
* Bits de configuração do PIC18F4550 
*--------------------------------------*/
// Oscilador e outras definicoes de registradores	
#pragma config FOSC     = HS     // (8 MHz)
#pragma config IESO     = OFF
#pragma config PWRT     = OFF
#pragma config BORV     = 3
#pragma config WDT      = OFF
#pragma config WDTPS    = 32768
#pragma config MCLRE    = ON
#pragma config LPT1OSC  = OFF
#pragma config PBADEN   = OFF
#pragma config STVREN   = ON
#pragma config LVP      = OFF

#define VETOR_PRINCIPAL 384
#define VETOR_AUXILIAR 6
#define TAM_NUM 5

/*Área que define o tamanho de memória alocada para os vetores iniciais*/
#pragma romdata DATAX 
const rom float x[VETOR_PRINCIPAL] = 
		   {0.,1.,2.,3.,4.,5.,6.,7.,8.,9.,10.,11.,12.,
			13.,14.,15.,16.,17.,18.,19.,20.,21.,22.,23.,24.,
			25.,26.,27.,28.,29.,30.,31.,32.,33.,34.,35.,36.,
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			373.,374.,375.,376.,377.,378.,379.,380.,381.,382.,383.};
#pragma romdata

#pragma romdata DATAY 
const rom float y[VETOR_PRINCIPAL] = 
		    {3.70439,3.78823,1.33636,4.94159,1.18643,82.71557,
	        99.54162,77.81941,91.74496,58.02974,57.54860,43.43887,
	        64.60021,46.32540,49.72529,67.42367,35.20597,55.19687,
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			118.60826,92.55926,104.31152,29.65341,33.93534,42.28892};
#pragma romdata
/*******/

/*Protótipo de funções*/
void inicializarSerial(void);
/******/


/*Função principal*/
void main(void)
{
    /*Inicialização das variáveis*/
    int n = VETOR_AUXILIAR - 1; //MAX Ã© o nÃºmero de pontos da entrada
	float xbuscado; // Valor a ser buscado
	float xi[VETOR_AUXILIAR], yi[VETOR_AUXILIAR]; //Vetor auxiliar

	//variáveis para definir vetor auxiliar
	int valorBuscado;
	int k, inicial;

	//variáveis para calcular lagrange
	double result = 0.0;
    double polinomio;
	int i, j;
	
	//variáveis auxilares para mostrar o float no LCD
	char resultado[10];
	int decimal, parte;
	
	//variáveis para ler e escrever na serial
	char xbusc[TAM_NUM];	
	char msg_1[11] = "\nEntrada: ";
	char msg_2[13] = "\tResultado: ";

	//Iniciliza a serial
	inicializarSerial();

	//Leitura do x buscado, pelo teclado.
	putsUSART(msg_1);
	while(!DataRdyUSART());
	getsUSART(xbusc, TAM_NUM);
	putsUSART(xbusc);

	//Conversão do x buscado para um valor float
	xbuscado = atof(xbusc);

    /*Define o vetor auxiliar*/
	valorBuscado = (int)xbuscado;
	if (valorBuscado <= 1) inicial = 0; //Se menor igual a 1, o vetor auxiliar Ã© formado pelos 6 primeiros pontos do vetor original.
	else if  (valorBuscado > VETOR_PRINCIPAL-4) inicial = VETOR_PRINCIPAL-6; //Se maior que MAX-4, o vetor auxiliar Ã© formado pelos 6 Ãºltimos pontos do vetor original.
	else inicial = valorBuscado-2; // Se nÃ£o, o valor inicial sÃ£o duas posiÃ§Ãµes antes do buscado.
	
	//Preenche o vetor auxiliar
	for (k=0; k<= VETOR_AUXILIAR-1; k++)
	{
        xi[k] = x[inicial];
		yi[k] = y[inicial];
	
        inicial++;
	}

    //Chamada da funÃ§Ã£o lagrange
	for (i=0;i<=n;i++)
	{
		polinomio=1.0;

		for (j=0;j<=n;j++)//Varia atÃ© o valor do grau do polinÃ´mio.
		if (i!=j)//i deve ser diferente de j para que o denominador nÃ£o seja igual a zero.
		polinomio = polinomio * (xbuscado - xi[j]) / (xi[i] - xi[j]);//PolinÃ´mio interpolador de Lagrange.
	
		result = result + polinomio * yi[i];
	}

	//Conversão do resultado float para string
	parte = result;
	decimal = (result - parte)*1000;
	sprintf(resultado, "%d.%d", parte, decimal);

	//Imprime o resultado na serial
	putsUSART(msg_2);
	putsUSART(resultado);	

}
/*******/

/*Configura e habilita a comunicação serial*/
void inicializarSerial()
{
	RCSTAbits.SPEN = 1;
	TRISCbits.TRISC7 = 1;
	TRISCbits.TRISC6 = 1;
	TXSTAbits.TXEN = 1;
	RCSTAbits.CREN = 1;	

	OpenUSART(	USART_TX_INT_OFF & 
				USART_RX_INT_OFF & 
				USART_ASYNCH_MODE & 
				USART_EIGHT_BIT &
				USART_CONT_RX &
				USART_BRGH_HIGH,51);
}
/******/